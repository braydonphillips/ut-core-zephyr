## west.yml
```yaml
# ut-core/west.yml
manifest:
  defaults:
    remote: upstream

  remotes:
    - name: upstream
      url-base: https://github.com/zephyrproject-rtos

  projects:
    - name: zephyr
      remote: upstream
      revision: v3.6.0  # or whatever version you want
      import: true

  self:
    path: ut-core
```
